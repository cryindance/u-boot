## board/nuclei/generic/Kconfig
```kconfig
if TARGET_NUCLEI_GENERIC_SOC

config SYS_BOARD
	default "generic"

config SYS_VENDOR
	default "nuclei"

config SYS_CPU
	default "nuclei"

config SYS_CONFIG_NAME
	default "nuclei-generic"

config TEXT_BASE
	default 0xA0200000 if SPL
	default 0xA0000000 if !RISCV_SMODE
	default 0xA0200000 if RISCV_SMODE

config SPL_TEXT_BASE
	default 0x90000000

config SPL_OPENSBI_LOAD_ADDR
	default 0xc0000000

config BOARD_SPECIFIC_OPTIONS # dummy
	def_bool y
	select NUCLEI_RISCV
	select SUPPORT_SPL
	imply CMD_EXT2
	imply CMD_EXT4
	imply CMD_FAT
	imply CMD_FS_GENERIC
	imply CMD_SF
	imply DOS_PARTITION
	imply NUCLEI_SERIAL
	imply SPI
	imply NUCLEI_SPI
	imply SPI_FLASH
	imply SPI_FLASH_ISSI
	imply MMC
	imply MMC_SPI
	imply MMC_BROKEN_CD
	imply CMD_MMC
	imply SMP
	imply OF_HAS_PRIOR_STAGE
	imply SPL_RAM_SUPPORT

endif
```
